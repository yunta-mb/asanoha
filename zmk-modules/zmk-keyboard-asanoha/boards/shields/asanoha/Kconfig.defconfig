## zmk-modules/zmk-keyboard-asanoha/boards/shields/asanoha/Kconfig.defconfig
```kconfig
if SHIELD_ASANOHA_LEFT

config ZMK_KEYBOARD_NAME
    default "Asanoha"

config ZMK_SPLIT_ROLE_CENTRAL
    default y

endif



if SHIELD_ASANOHA_LEFT || SHIELD_ASANOHA_RIGHT

config ZMK_SPLIT
    default y

config I2C
    default y

config GPIO_MCP230XX
    default y

#config BOARD_ENABLE_DCDC_HV
#    default n

endif
```

## zmk-modules/zmk-keyboard-asanoha/boards/shields/asanoha/Kconfig.shield
```kconfig
config SHIELD_ASANOHA_LEFT
    def_bool $(shields_list_contains,asanoha_left)

config SHIELD_ASANOHA_RIGHT
    def_bool $(shields_list_contains,asanoha_right)
```
